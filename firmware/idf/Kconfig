## firmware/idf/Kconfig
```kconfig
menu "Meshnet Audio Config"

config MESHNET_GPIO_MODE_SWITCH
    int "GPIO for TX/RX mode switch"
    default 10
    help
        GPIO number used to select TX(1)/RX(0) at boot for the dual-mode app.

config MESHNET_USE_USB_AUDIO
    bool "Use USB Audio (UAC) for I/O"
    default y

config MESHNET_USE_I2S_AUDIO
    bool "Use I2S Audio for I/O"
    default n

endmenu
```

## firmware/idf/apps/rx/sdkconfig.defaults
```kconfig
# ESP32-S3 Configuration
CONFIG_IDF_TARGET="esp32s3"
CONFIG_ESP32S3_SPIRAM_SUPPORT=y
CONFIG_SPIRAM=y

# WiFi Mesh
CONFIG_ESP_WIFI_MESH_ENABLE=y

# Audio Performance
CONFIG_ESP_DEFAULT_CPU_FREQ_MHZ_240=y
CONFIG_FREERTOS_HZ=1000

# ESP-ADF Compatibility
CONFIG_FREERTOS_ENABLE_BACKWARD_COMPATIBILITY=y
```

## firmware/idf/apps/tx/sdkconfig.defaults
```kconfig
# ESP32-S3 Configuration
CONFIG_IDF_TARGET="esp32s3"

# WiFi Mesh
#CONFIG_ESP_WIFI_MESH_ENABLE=y

# Audio Performance
CONFIG_ESP_DEFAULT_CPU_FREQ_MHZ_240=y
CONFIG_FREERTOS_HZ=1000

# ESP-ADF Compatibility
CONFIG_FREERTOS_ENABLE_BACKWARD_COMPATIBILITY=y

# USB OTG (TinyUSB via esp_tinyusb component)
CONFIG_TINYUSB=y
CONFIG_TINYUSB_ENABLED=y

# TinyUSB Audio Class Device
CONFIG_TINYUSB_AUDIO_ENABLED=y
CONFIG_TINYUSB_AUDIO_FUNC_COUNT=1

# USB Device Configuration
CONFIG_TINYUSB_DESC_USE_ESPRESSIF_VID=n
CONFIG_TINYUSB_DESC_CUSTOM_VID=0x303A
CONFIG_TINYUSB_DESC_CUSTOM_PID=0x4002
CONFIG_TINYUSB_DESC_MANUFACTURER_STRING="Espressif"
CONFIG_TINYUSB_DESC_PRODUCT_STRING="ESP32-S3 Audio Output"
CONFIG_TINYUSB_DESC_SERIAL_STRING="123456"
CONFIG_TINYUSB_DESC_BCD_DEVICE=0x0100

# Disable USB Serial/JTAG console (conflicts with USB OTG audio)
CONFIG_ESP_CONSOLE_USB_SERIAL_JTAG=n
CONFIG_ESP_CONSOLE_SECONDARY_USB_SERIAL_JTAG=n
CONFIG_ESP_CONSOLE_UART_DEFAULT=y
```

## firmware/idf/sdkconfig.defaults
```kconfig
# XIAO-ESP32-S3 baseline
CONFIG_IDF_TARGET_ESP32S3=y
CONFIG_ESP_CONSOLE_UART=y
CONFIG_ESP_CONSOLE_UART_DEFAULT=y
CONFIG_ESP_SYSTEM_PANIC_PRINT_HALT=y

# WiFi / Mesh
CONFIG_ESP_WIFI_ENABLED=y
CONFIG_MESH_ID="1234567890123456"
CONFIG_MESH_ROUTE_TABLE_SIZE=50
CONFIG_MESH_ROOT_HEALING=y
CONFIG_MESH_ENABLE=y

# PSRAM
CONFIG_SPIRAM=y
CONFIG_SPIRAM_BOOT_INIT=y
CONFIG_SPIRAM_USE_MALLOC=y
CONFIG_SPIRAM_TRY_ALLOCATE_WIFI_LWIP=y
CONFIG_SPIRAM_MEMTEST=y

# USB Device (for UAC)
CONFIG_TINYUSB_ENABLED=y
CONFIG_TINYUSB_DEVICE_ENABLED=y

# ADF Opus
CONFIG_AUDIO_HEAP_MODE_DEFAULT=y

# Logging
CONFIG_LOG_DEFAULT_LEVEL_INFO=y
```

## firmware/platformio/tx/sdkconfig.defaults
```kconfig
# ESP32-S3 Configuration
CONFIG_IDF_TARGET="esp32s3"

# WiFi Mesh
#CONFIG_ESP_WIFI_MESH_ENABLE=y

# Audio Performance
CONFIG_ESP_DEFAULT_CPU_FREQ_MHZ_240=y
CONFIG_FREERTOS_HZ=1000

# ESP-ADF Compatibility
CONFIG_FREERTOS_ENABLE_BACKWARD_COMPATIBILITY=y

# Flash Configuration (8MB flash on XIAO ESP32-S3)
CONFIG_ESPTOOLPY_FLASHSIZE_8MB=y
CONFIG_ESPTOOLPY_FLASHSIZE="8MB"

# USB OTG (TinyUSB built into ESP-IDF v5.x) - DISABLED for MVP
# TODO: Re-enable for USB audio in Phase 3
# CONFIG_TINYUSB=y
# CONFIG_TINYUSB_CDC_ENABLED=n
# CONFIG_TINYUSB_MSC_ENABLED=n
# CONFIG_TINYUSB_HID_ENABLED=n
# CONFIG_TINYUSB_MIDI_ENABLED=n
# CONFIG_TINYUSB_CUSTOM_CLASS_ENABLED=n
# CONFIG_TINYUSB_NET_MODE_NCM=n
# CONFIG_TINYUSB_NET_MODE_ECM_RNDIS=n
# CONFIG_TINYUSB_DFU_RT_ENABLED=n

# Enable USB Device Mode - DISABLED for MVP
# CONFIG_USB_OTG_SUPPORTED=y
# CONFIG_USB_HOST_CONTROL_TRANSFER_MAX_SIZE=256

# Use UART console for now
CONFIG_ESP_CONSOLE_UART_DEFAULT=y
```

## sdkconfig.defaults
```kconfig
# Flash size configuration
CONFIG_ESPTOOLPY_FLASHSIZE_8MB=y
CONFIG_PARTITION_TABLE_CUSTOM=y
```
