#include "control/ui.h"
#include "esp_log.h"
#include "ssd1306.h"
#include <stdio.h>
#include <string.h>
#include <math.h>

#ifndef M_PI
#define M_PI 3.14159265358979323846
#endif

static const char *TAG = "ui";

struct ui_handle_s {
    ssd1306_handle_t ssd1306_dev;
    bool is_tx;
    int last_display_mode;
};

// Minimal 5x7 font bitmap (ASCII 32-126)
static const uint8_t font_5x7[][5] = {
    {0x00, 0x00, 0x00, 0x00, 0x00}, {0x00, 0x00, 0x5F, 0x00, 0x00},
    {0x00, 0x07, 0x00, 0x07, 0x00}, {0x14, 0x7F, 0x14, 0x7F, 0x14},
    {0x24, 0x2A, 0x7F, 0x2A, 0x12}, {0x23, 0x13, 0x08, 0x64, 0x62},
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    {0x44, 0x64, 0x54, 0x4C, 0x44},
};

static void draw_char(ssd1306_handle_t dev, char c, int x, int y) {
    if (c < 32 || c > 122) return;
    const uint8_t *glyph = font_5x7[c - 32];
    for (int col = 0; col < 5; col++) {
        uint8_t line = glyph[col];
        for (int row = 0; row < 7; row++) {
            if (line & (1 << row)) {
                ssd1306_set_pixel(dev, x + col, y + row, false);
            }
        }
    }
}

static void draw_text(ssd1306_handle_t dev, const char *str, int x, int y) {
    while (*str) {
        draw_char(dev, *str, x, y);
        x += 6;
        str++;
    }
}

static void clear_area(ssd1306_handle_t dev, int x1, int y1, int x2, int y2) {
    for (int y = y1; y < y2; y++) {
        for (int x = x1; x < x2; x++) {
            ssd1306_set_pixel(dev, x, y, true);
        }
    }
}

esp_err_t ui_init(const ui_config_t *config, ui_handle_t *out_handle) {
    if (!config || !out_handle) {
        return ESP_ERR_INVALID_ARG;
    }

    ui_handle_t handle = malloc(sizeof(struct ui_handle_s));
    if (!handle) {
        return ESP_ERR_NO_MEM;
    }

    handle->is_tx = config->is_tx;
    handle->last_display_mode = -1;

    ssd1306_config_t ssd1306_config = I2C_SSD1306_128x32_CONFIG_DEFAULT;
    esp_err_t ret = ssd1306_init(config->i2c_bus, &ssd1306_config, &handle->ssd1306_dev);
    if (ret != ESP_OK) {
        free(handle);
        return ret;
    }

    ssd1306_clear_display(handle->ssd1306_dev, false);
    draw_text(handle->ssd1306_dev, config->is_tx ? "TX Ready" : "RX Ready", 0, 0);
    ssd1306_display_pages(handle->ssd1306_dev);

    *out_handle = handle;
    ESP_LOGI(TAG, "UI initialized (%s)", config->is_tx ? "TX" : "RX");
    return ESP_OK;
}

esp_err_t ui_update_tx(ui_handle_t handle, const tx_status_t *status, display_mode_t mode) {
    if (!handle || !status) {
        return ESP_ERR_INVALID_ARG;
    }

    char buf[32];

    if (mode != handle->last_display_mode) {
        clear_area(handle->ssd1306_dev, 0, 0, 128, 32);
        handle->last_display_mode = mode;
    }

    if (mode == DISPLAY_MODE_PRIMARY) {
        clear_area(handle->ssd1306_dev, 0, 8, 128, 32);
        
        if (status->is_streaming) {
            draw_text(handle->ssd1306_dev, "Streaming...", 0, 0);
            for (int x = 0; x < 128; x++) {
                float phase = ((float)x / 128.0f) * 2.0f * M_PI + 
                             (float)(status->frame_counter % 100) * 0.1f;
                int y = 20 + (int)(sin(phase) * 8.0f);
                if (y >= 8 && y < 32) {
                    ssd1306_set_pixel(handle->ssd1306_dev, x, y, false);
                }
            }
        } else {
            draw_text(handle->ssd1306_dev, "Waiting...", 0, 0);
            for (int x = 0; x < 128; x++) {
                ssd1306_set_pixel(handle->ssd1306_dev, x, 20, false);
            }
        }
    } else {
        clear_area(handle->ssd1306_dev, 0, 0, 128, 16);
        const char *mode_str = (status->audio_mode == AUDIO_INPUT_TONE) ? "Tone" :
                               (status->audio_mode == AUDIO_INPUT_USB) ? "USB" : "AUX";
        snprintf(buf, sizeof(buf), "Input: %s", mode_str);
        draw_text(handle->ssd1306_dev, buf, 0, 0);
        snprintf(buf, sizeof(buf), "RX: %d", status->rx_node_count);
        draw_text(handle->ssd1306_dev, buf, 0, 8);
    }

    return ssd1306_display_pages(handle->ssd1306_dev);
}

esp_err_t ui_update_rx(ui_handle_t handle, const rx_status_t *status, display_mode_t mode) {
    if (!handle || !status) {
        return ESP_ERR_INVALID_ARG;
    }

    char buf[32];

    if (mode != handle->last_display_mode) {
        clear_area(handle->ssd1306_dev, 0, 0, 128, 32);
        handle->last_display_mode = mode;
    }

    if (mode == DISPLAY_MODE_PRIMARY) {
        clear_area(handle->ssd1306_dev, 0, 0, 128, 16);
        snprintf(buf, sizeof(buf), "RSSI:%ddBm H:%d", status->wifi_rssi, status->mesh_hops);
        draw_text(handle->ssd1306_dev, buf, 0, 0);
        snprintf(buf, sizeof(buf), "Lat:~%dms", status->mesh_hops * 10);
        draw_text(handle->ssd1306_dev, buf, 0, 8);
    } else {
        clear_area(handle->ssd1306_dev, 0, 8, 128, 32);
        
        if (status->is_streaming) {
            draw_text(handle->ssd1306_dev, "Receiving...", 0, 0);
            for (int x = 0; x < 128; x++) {
                float phase = ((float)x / 128.0f) * 2.0f * M_PI + 
                             (float)(status->frame_counter % 100) * 0.1f;
                int y = 20 + (int)(sin(phase) * 8.0f);
                if (y >= 8 && y < 32) {
                    ssd1306_set_pixel(handle->ssd1306_dev, x, y, false);
                }
            }
        } else {
            draw_text(handle->ssd1306_dev, "Waiting...", 0, 0);
        }
        
        snprintf(buf, sizeof(buf), "%.1fKB/s", (float)status->bytes_received / 1024.0f);
        draw_text(handle->ssd1306_dev, buf, 0, 24);
    }

    return ssd1306_display_pages(handle->ssd1306_dev);
}

void ui_deinit(ui_handle_t handle) {
    if (handle) {
        free(handle);
        ESP_LOGI(TAG, "UI deinitialized");
    }
}
